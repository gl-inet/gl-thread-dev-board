## boards/arm/gl_thread_dev_board/Kconfig.board
```kconfig
config BOARD_GL_THREAD_DEV_BOARD
	bool "GL Thread Dev Board"
	depends on SOC_NRF52840_QIAA
```

## boards/arm/gl_thread_dev_board/Kconfig.defconfig
```kconfig
if BOARD_GL_THREAD_DEV_BOARD

config BOARD
	default "gl-thread-dev-board"

config BT_CTLR
	default BT

endif # BOARD_GL_THREAD_DEV_BOARD
```
